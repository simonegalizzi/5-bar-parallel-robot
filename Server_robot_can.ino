
#include <WiFi.h>
#include <ESP32WebServer.h>
#include <WebSocketsServer.h>
#include <df_can.h>
#include <SPI.h>


// Value Limits
#define P_MIN -12.5f
#define P_MAX 12.5f
#define V_MIN -12.5f
#define V_MAX 12.5f




static const byte MCP2515_SCK  = 18 ; // SCK input of MCP2517 
static const byte MCP2515_MOSI = 23 ; // SDI input of MCP2517  
static const byte MCP2515_MISO = 19 ; // SDO output of MCP2517 
const int SPI_CS_PIN = 5;
  
MCPCAN CAN(SPI_CS_PIN);                                    // Set CS pin
// Write wifi network and password
const char* ssid_wifi = "******";
const char* password_wifi = "******"; 
// Static variables used in WebSocketEvent_vd() function to manage data recieved from the webpage
static char *dataJoy;
static int16_t coordenadas[7];
static int16_t i;
char comando[7];
String angoloStringa;
String setup_motore= "";  //variabile per memorizzare il comando che arriva dal ws
bool ab = false;   //variabile per concatenare cio che arriva dal ws x setup motore
bool invioA=false;
bool invioB=false;
//Variables used in the handleData() function to properly detect when the buttons are pressed
int posX_joy = 0;
int posY_joy = 190;
byte save, play, stap, reset, demoM, demoC; 
byte inviosetup[7];
bool primo_avvio = true;
//Web page developed in HTML and JS codified in HEX
static const char INDEX_HTML[] PROGMEM ={0x1f,0x8b,0x08,0x08,0x6d,0xb5,0xce,0x62,0x00,0xff,0x69,0x6e,0x64,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0x00,0x00}; 

//Creates web server on port 80 and creates a web socket server
ESP32WebServer server (80); 
WebSocketsServer webSocket = WebSocketsServer(8001);




//Time managing variables
float runTime, prevT = 0, timeDif, stateT;
int sp = 0, limit, timeInterval = 12000;
byte machineState = 0;

typedef struct struct_message {
    float a;
    float b;
    char conf[8];
    bool news;
} struct_message;

struct_message dagorData;
String comando_da_utente;
//Five Bar Parrallel Robot constants
const int l0 = 140;
const int l1 = 170;
const int l2 = 245;
const int l3 = 245;
const int l4 = 170;

//Angles calculated from the inverse kinematic model
float angleA, angleB,precA,precB;


//Circle DEMO angular positions for each motor [rad]
float circleA[] = {-0.3941,-0.4402,-0.4856,-0.5301,-0.5737,-0.616,-0.6569,-0.6963,-0.7337,-0.769,-0.8017,-0.8316,-0.858,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-0.3474,-0.3941};
float circleB[] = {-1.1362,-1.1087,-1.0798,-1.0492,-1.0171,-0.9832,-0.9475,-0.9099,-0.8703,-0.8286,-0.7848,-0.7386,-0.6901,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-1.1621,-1.1362};

//Four-points DEMO - Here is the best place to program your own sequences
float coinsA[] = {-1.5, 1, 1.6, 0.5};
float coinsB[] = {-1.1, 2, 0, -1};

//Array with fixed size for saved positions
static float posA[50];
static float posB[50];

//Target variable, works if virtual joystick is disabled
float target = 0;
int savedIndex = 0;
// loop stats variables
unsigned long t = 0;
long timestamp = micros();




void handleData();
void inverseKinemstics();




void setup() {
  Serial.begin(115200);

  SPI.begin (MCP2515_SCK, MCP2515_MISO, MCP2515_MOSI) ;
  int count = 50;                                     // the max numbers of initializint the CAN-BUS, if initialize failed first!.  
      
      do {
          CAN.init();   //must initialize the Can interface here! 
          if(CAN_OK == CAN.begin(CAN_500KBPS))                   // init can bus : baudrate = 500k
          {
              Serial.println("CanBus inizializzato");
              break;
          }
          else
          {
              Serial.println("Errore inizializzazione canbus");
              delay(100);
              if (count <= 1)
                  Serial.println("riprovo a inizializzare il canbus");
          }
  
      }while(count--);
  
  //Wifi initialization
  WiFi.mode(WIFI_STA);
  WiFi.begin(ssid_wifi, password_wifi);
  Serial.print("Conectando a:\t");
  Serial.println(ssid_wifi); 
  
  // Waits for connection to be established
  while (WiFi.status() != WL_CONNECTED){
    delay(200);
    Serial.print('.');
  }
  

  delay(2000);
  
  //Print server IP to virtual COM
  Serial.println(WiFi.localIP());

  server.on("/", []() {                              
      server.sendHeader("content-encoding","gzip");                             
      server.send_P(200, "text/html", INDEX_HTML,sizeof(INDEX_HTML));     
  });
  server.begin();                                   
  Serial.println("WebServer initiated...");  

  webSocket.begin();
  /*Event of the WebSocket*/
  webSocket.onEvent(WebSocketEvent_vd);
  
  //Print starting system gains, can be changed though the virtual COM
  dagorData.news=false;
  inverseKinematics(0,190);
  Serial.print("Motor A angle: "+String(angleA));Serial.print("Motor B angle: "+String(angleB));
  angleA=0;
  angleB=0;
  precA=0;
  precB=0;
}

void loop() {
 

 
  
  //Function intended to be used with serial plotter to monitor motor variables, significantly slowing the execution down!!!!
  //motor_monitor();

  // STATE MACHINE
  if ((machineState == 0)&&(primo_avvio==false)&&(coordenadas[1]!=0)){   //Default, Robot control through wifi controller
    inverseKinematics(posX_joy, posY_joy);
    //motor.move(angleA);
    //motorB.move(angleB);
   
    
 
   angleA=(angleA*13.6);
   angleB=(angleB*13.6);
    
    
    //esp_err_t result = esp_now_send(broadcastAddress1, (uint8_t *) &dagorData, sizeof(dagorData));
    if (precA!=angleA) {
             //  Serial.print("Motor A angle: "+String(angleA));Serial.print("Motor B angle: "+String(angleB));
               //Serial.println();
               //invio cordinate
               pack_cmd();
               precA = angleA; 
               precB =angleB; 
        }
    
  }
  else if ( machineState == 3){   //Saved positions DEMO
     //motor.move(posA[sp]);
     //motorB.move(posB[sp]);
    
    
     //esp_err_t result = esp_now_send(broadcastAddress, (uint8_t *) &dagorData, sizeof(dagorData));
     //esp_err_t result1 = esp_now_send(broadcastAddress1, (uint8_t *) &dagorData, sizeof(dagorData));
  }
  else if ( machineState == 6){   //Circle DEMO
    //motor.move(circleA[sp]+0.6);
    //motorB.move(circleB[sp]+0.6);

     
     //esp_err_t result1 = esp_now_send(broadcastAddress1, (uint8_t *) &dagorData, sizeof(dagorData));
     
  }
  else if ( machineState == 7){   //Coins DEMO
    //motor.move(coinsA[sp]);
    //motorB.move(coinsB[sp]);
    
   
  }


  //Time managment for dinamic movement DEMOs
  runTime = micros();
  timeDif = runTime - prevT;  //How much time each loop takes
  prevT = runTime;
  stateT += timeDif;

  if(sp == limit){
    sp = 0 ;
  }
  
  if(stateT >= timeInterval && (machineState == 6 || machineState == 7 || machineState == 3 )){
    sp += 1;
    stateT = 0;
    //Serial.println(sp);
  }
  
  server.handleClient();
  webSocket.loop();                                       
  handleData();
}

//Inverse kinematic model. Accepts x and y positions [mm] from the virtual joystick and returns motors' angles [rad].
void inverseKinematics(int posX, int posY){
   /* if (posX == 0 && posY == 0){
    posX = 330;
    posY = 390;
  }*/
  //if ((posX==0)&&(posY==190)){
  //  angleA=0;
  ////  angleA=0;
 // }else{
  //if (posY < 0) posY = 1;
  //posX = (posX - 330);
  //posY = 400 - posY;
  //if (posY <= 0) posY = 0;
  
  float dA = sqrt((posY*posY)+(((l0/2)+posX)*((l0/2)+posX)));
  float argA = ((dA*dA)+(l1*l1)-(l2*l2))/(2*dA*l1);
  if (argA >= 1) argA = 1;
  else if (argA <= 0) argA = 0;
  float phiA = acos(argA);
  float thetaA = atan2(posY,((l0/2)+posX));
//  if (posY <= 190){
    
   // angleA = -( PI- (thetaA + phiA))+0.5;
    //angleA = angleA*-1;
  //}
 // else{
    angleA = ( PI - (thetaA + phiA ));//-0.5;
 // }

  
  float dB = sqrt((posY*posY)+(((l0/2)-posX)*((l0/2)-posX)));
  float argB = ((dB*dB)+(l4*l4)-(l3*l3))/(2*dB*l4);
  if (argB >= 1) argB = 1;
  else if (argB <= 0) argB = 0;
  float phiB = acos(argB);
  float thetaB = atan2(posY,((l0/2)-posX));
 // if (posY <= 190){
    
 //   angleB = (PI-(thetaB + phiB))-0.5;
 // }
 // else{
    angleB = -( PI -(thetaB + phiB ));//+0.5;
  //}
   
  //Serial.print("posX: ");
  //Serial.print(posX);
  //Serial.print(", posY: ");
  //Serial.print(posY);
  //Serial.println(thetaA);
  //Serial.println(dA);
  //Serial.println(argA);
  //Serial.println(phiA);
  //Serial.print(", angleA: ");
  //Serial.print(angleA);
  //Serial.print(", angleB: ");
  //Serial.println(angleB);
 //   }
}

//Function that manages each button input
void handleData(){
  if(dagorData.news==true){
    for(int z=0;z<=8;z++){
      dagorData.conf[z]=comando_da_utente[z];
    }
    Serial.println("comando mot"+String(dagorData.conf));
  }else{
  if (coordenadas[0]!= posX_joy || coordenadas[1]!=posY_joy)
  {
    /*Serial.print("X:");
    Serial.print(coordenadas[0]);
    Serial.print("\t");
    Serial.print("Y:");
    Serial.println(coordenadas[1]);*/
  }
  if(coordenadas[2]==1 && save!=coordenadas[2]){
    Serial.println("Position saved");
    posA[savedIndex] = precA;
    posB[savedIndex] = precB;
    Serial.print("Motor A angle: ");
    Serial.println(posA[savedIndex]);
    Serial.print("Motor B angle: ");
    Serial.println(posB[savedIndex]);
    Serial.print("Saved Position Index: ");
    Serial.println(savedIndex);
    savedIndex += 1;
  }
  else if(coordenadas[3]==1 && play!=coordenadas[3] ){
    if(posA[0] == 0 && posB[0] == 0){
      Serial.println("No points saved.");
    }
    else{
      Serial.println("Play saved positions");
      timeInterval = 500000;
      limit = savedIndex;
      sp = 0;
     
      machineState = 3;
    }
  }
  else if(coordenadas[4]==1 && stap!=coordenadas[4]){
    Serial.println("Stop");
   
   
    angleA=0;
    angleB=0;
    machineState = 0;
    
  }
  else if(coordenadas[5]==1 && reset!=coordenadas[5]){
    Serial.println("Reset saved positions");
    savedIndex = 0;
    limit = 0;
    sp = 0;
    
   
    machineState = 0;
    memset(posA, 0, sizeof(posA));
    memset(posB, 0, sizeof(posB));
  }
  else if(coordenadas[6]==1 && demoC!=coordenadas[6]){
    Serial.println("Circle DEMO");
    limit = 100;
    timeInterval = 15000;
    sp = 0;
    machineState = 6;
  }
  else if(coordenadas[7]==1 && demoM!=coordenadas[7]){
    Serial.println("Coins DEMO");
    limit = 4;
    timeInterval = 500000;
    sp = 0;
    machineState = 7;
  }

  posX_joy=coordenadas[0];
  posY_joy=coordenadas[1];
  save = coordenadas[2];
  play = coordenadas[3];
  stap = coordenadas[4];
  reset = coordenadas[5];
  demoC = coordenadas[6];
  demoM = coordenadas[7];
  }
}



//Web sockets event handle. Transforms the values recieved from the webpage into an array.
void WebSocketEvent_vd(uint8_t num_u8s, WStype_t type_ws, uint8_t *payload_u8sp, size_t length) {
    switch(type_ws) 
    {
        /*When there is a new connection sends a string of "0"*/
        case WStype_CONNECTED: 
        {
          Serial.println("Client connected.");
          primo_avvio=false;
        }
        break;
        /*When there is a new connection sends a string of "0"*/
        case WStype_DISCONNECTED:
        {
          Serial.println("Client disconnected.");
        }
        break;
        /*When there is new data available from the HTML*/
        case WStype_TEXT:
        {
            dataJoy = (char*)payload_u8sp;  
            if ((dataJoy[0]=='A')||(dataJoy[0]=='B')) {
              comando_da_utente=dataJoy;
              dagorData.news=true; 
            }else{
            char delimiter [] = " ";
            char* rest = strtok (dataJoy, delimiter);
            i=0; 
            while(rest != NULL) 
            {
              coordenadas[i]=atoi(rest);
              rest = strtok(NULL, delimiter);
              i++;
            }
            dagorData.news=false; 
            }
             
         
        }
        break;
        
        /*When there is an error in the WebSocket communication*/
        case WStype_ERROR:                                                                
        {
        }
        break;
    }
}

void pack_cmd(){
  byte bufA[8];
  byte bufB[8];

  /// CAN Command Packet Structure ///
  /// 16 bit position command, between -4*pi and 4*pi
  /// 12 bit velocity command, between -30 and + 30 rad/s
  /// 12 bit kp, between 0 and 500 N-m/rad
  /// 12 bit kd, between 0 and 100 N-m*s/rad
  /// 12 bit feed forward torque, between -18 and 18 N-m
  /// CAN Packet is 8 8-bit words
  /// Formatted as follows.  For each quantity, bit 0 is LSB
  /// 0: [position[15-8]]
  /// 1: [position[7-0]] 
  /// 2: [velocity[11-4]]
  /// 3: [velocity[3-0], kp[11-8]]
  /// 4: [kp[7-0]]
  /// 5: [kd[11-4]]
  /// 6: [kd[3-0], torque[11-8]]
  /// 7: [torque[7-0]]
  if (dagorData.news==false){
  /// limit data to be within bounds ///
  /*float p_des = constrain(angleA, P_MIN, P_MAX); //fminf(fmaxf(P_MIN, p_in), P_MAX);                    
  float v_des = constrain(angleB, V_MIN, V_MAX); //fminf(fmaxf(V_MIN, v_in), V_MAX);
 
  /// convert floats to unsigned ints ///
  Serial.println("angoloA "+String(p_des));
  Serial.println("angoloB "+String(v_des));
  unsigned int p_int = float_to_uint(p_des, P_MIN, P_MAX, 16);            
  unsigned int v_int = float_to_uint(v_des, V_MIN, V_MAX, 16);
 
  /// pack ints into the can buffer ///
*/
 /* buf[0] = p_int >> 8;                                       
  buf[1] = p_int & 0xFF;
  buf[2] = v_int >> 8;
  buf[3] = v_int & 0xFF;*/
  angoloStringa=String(angleA);
  for (i=0;i<=7;i++){
    bufA[i]=angoloStringa[i];
  }
  angoloStringa=String(angleB);
  for (i=0;i<=7;i++){
    bufB[i]=angoloStringa[i];
  }
  CAN.sendMsgBuf(0x01, 0, 8, bufA);
  CAN.sendMsgBuf(0x02, 0, 8, bufB);
 // Serial.println("inviato");
  }else{
    if (invioA==true){
    Serial.println("invio su can");  
    CAN.sendMsgBuf(0x02, 0, 8,inviosetup);
    ab=false;
    invioA=false;
    Serial.println("ab false inviato");
    }
    if (invioB==true){
    CAN.sendMsgBuf(0x03, 0, 8,inviosetup);
    ab=false;
    invioB=false;
    }
  }
}

unsigned int float_to_uint(float x, float x_min, float x_max, int bits){
  /// Converts a float to an unsigned int, given range and number of bits ///
  float span = x_max - x_min;
  float offset = x_min;
  unsigned int pgg = 0;
  if (bits == 12){
    pgg = (unsigned int) ((x-offset)*4095.0/span);
  }
  if (bits == 16){
    pgg = (unsigned int) ((x-offset)*65535.0/span);
  }
  return pgg;
}
